#include <stdint.h>
#include <stdio.h>

//MACROS

//For TIM5. Base address for TIM5 own in APB1 -> 0x40000C00
#define RCC_APB1ENR ((volatile uint32_t*)0x40023840) //pg.120. RCC_EnableRegister, b_p3.
#define TIM5_CR1 ((volatile uint32_t*)0x40000C00)    //pg 369. CounterRegister, b_p0 and b_p4. (maybe need activate CMS of CR1)
#define TIM5_SR ((volatile uint32_t*)0x40000C10)     //pg 374. StatusRegister, bp_0. Automatically 1 when CNT reset/overflow. Must be cleared manually writing 0.
#define TIM5_EGR ((volatile uint32_t*)0x40000C14)    //pg 376. EventGenerationRegister. b_p0
#define TIM5_PSC ((volatile uint32_t*)0x40000C28)    //pg 383. holds my value of PSC. raw 16bits.
#define TIM5_ARR ((volatile uint32_t*)0x40000C2C)    //pg 383. Holds target max count. raw 16bits
#define TIM5_CNT ((volatile uint32_t*)0x40000C24)    //pg 383. The live ticking clock value. raw 16 bits.

//For LD2
#define RCC_AHB1ENR ((volatile uint32_t*) 0x40023830)  //pg 119. EnableRegister for GPIOA.
#define GPIOA_MODER5 ((volatile uint32_t*) 0x40020000) //pg 150. ModerRegister. b_p11&10
#define GPIOA_BSRR ((volatile uint32_t*)0x40020018)    //pg 153. Bit set/reset register

//REMEMBER *macro |= (1 << b_p); Turn on.   *macro &= ~(1 << b_p); Turn off
int main(void)
{
	//Enable GPIOA clock (bit 0)
	*RCC_AHB1ENR |= (1 << 0); //IO port A clock enable

	// Enable TIM5 Clock in RCC_APB1ENR (bit 3)
	*RCC_APB1ENR |= (1 << 3); //TIM5 clock enable

	//Configure PA5 (LD2) as output (Bits 11:10 = 01)
	*GPIOA_MODER5 &= ~(3 << (5*2)); //turn off bits 11:10.
	*GPIOA_MODER5 |= (1 << 10);     //turn on bit 10. MODER5 become output.

	//--- TIM5 INITIALIZATION ---
	*TIM5_PSC = 15;                //1 us resolution. (16MHz / (15+1) = 1MHz). T de 1MHz = 1us.
	*TIM5_ARR = 0xFFFFFFFF;        //max 32-bit value.
	*TIM5_EGR |= (1 << 0);       //Write 1 to UG bit to apply prescaler immediatly.
	*TIM5_SR |= (1 << 0);          //Clear UIF bit in SR generated by UG.
	*TIM5_CR1 |= (1 << 0);         //Write 1 to CEN bit to turn on timer.


// --- NON-BLOCKING MAIN LOOP ---
	uint32_t last_time = *TIM5_CNT; //Capture initial timestamp
	while (1) {
		//Non-blocking timestamp check for 500,000us (0.5 sec)
		if ((*TIM5_CNT - last_time) >= 3000000 ) {
			//Toggle PA5 using BSRR atomic bit flips
			//Bit 5 = set HIGH (ON), bit 21 (5+16) = Reset LOW (OFF)
			static uint8_t led_state = 0;
			if (led_state == 0) {
				*GPIOA_BSRR = (1 << 5); //(set PA5 HIGH). Push and keep on the button
				led_state = 1;
			}
			else {
				*GPIOA_BSRR = (1 << (5+16)); //(set PA5 LOW). Leave the finger of the button
				led_state = 0;
			}
			last_time = *TIM5_CNT; //Save current timestamp as new reference
		}
		//Other background code can run here smoothly
	}
	return 0;
}




